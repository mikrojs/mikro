## packages/@mikrojs/firmware/components/mikrojs/Kconfig
```kconfig
menu "mikrojs console"

    config MIKROJS_CONSOLE_FALLBACK_UART
        bool "Install UART0 as fallback console on chips with USB-Serial/JTAG"
        default n
        depends on SOC_USB_SERIAL_JTAG_SUPPORTED
        help
            When enabled, mikrojs brings up both USB-Serial/JTAG and UART0
            at boot and latches to whichever receives the first byte.
            Convenient for dev: plug in either cable type and it just
            works. Costs ~4 KB DRAM (UART RX ring buffer), a UART ISR
            in IRAM, and keeps UART0 clocks powered — meaningful on
            RAM-constrained apps (e.g. ones that push large SPI DMA
            frames and already run the system heap close to full).

            Defaults off to keep RAM available for the application.
            Enable if you want the auto-detect dev experience on a board
            where you sometimes connect a USB-TTL adapter instead of
            (or in addition to) the native USB port. On chips without
            USB-Serial/JTAG hardware (plain ESP32), UART0 is always
            installed regardless of this option.

endmenu

menu "mikrojs power"

    config MIKROJS_AUTO_LIGHT_SLEEP
        bool "Enter light sleep automatically when idle (experimental)"
        default n
        # select skips PM_ENABLE's own conditions, so repeat them here.
        depends on SOC_PM_SUPPORTED && !FREERTOS_SMP
        depends on ESP_CONSOLE_USB_SERIAL_JTAG_ENABLED
        depends on !MIKROJS_CONSOLE_FALLBACK_UART
        select PM_ENABLE
        select PM_DFS_INIT_AUTO
        select FREERTOS_USE_TICKLESS_IDLE
        select USJ_NO_AUTO_LS_ON_CONNECTION
        help
            When enabled, the chip enters light sleep whenever no task needs
            to run and no driver holds a power lock, and wakes for the next
            timer. It also turns on ESP-IDF power management with frequency
            scaling (DFS), which lowers the CPU clock while the app waits.

            MIK_Main switches light sleep on. A custom main that does not call
            MIK_Main gets frequency scaling and tickless idle but no light
            sleep, unless it calls esp_pm_configure itself.

            The USB-Serial/JTAG console stops in light sleep, so
            USJ_NO_AUTO_LS_ON_CONNECTION keeps the chip awake while a USB host
            is connected: the console, REPL and deploy work as before, and the
            savings start once the host is gone.

            An open Pwm, Uart, NeoPixel or I2s handle keeps the chip awake, and
            I2C and SPI transfers do too. WiFi sleeps between beacons in the
            "min" and "max" power save modes. BLE keeps the chip awake while
            the controller is enabled.

            Known limits: GPIO edges do not wake the chip, so an edge during
            sleep can be missed. A USB host plugged in while the chip sleeps
            can fail to enumerate; reset the board. On the ESP32-S3 the CPU
            state saved across sleep takes up to about 17 KB of internal RAM.

            Not available with a UART console (the ESP32, or
            MIKROJS_CONSOLE_FALLBACK_UART), since UART RX stops in light sleep.

endmenu

menu "mikrojs WiFi"

    config MIKROJS_WIFI
        bool "Compile the WiFi driver and the mikro/wifi module"
        default y
        depends on SOC_WIFI_SUPPORTED
        help
            When enabled, the firmware links the ESP-IDF WiFi driver
            (net80211, pp, wpa_supplicant) and provides the `mikro/wifi`
            module. The driver takes about 20 KB of internal RAM at boot
            whether or not the radio is ever started.

            Disable for apps that do all their networking over another
            link (a cellular modem on a UART, for instance) to get that
            RAM back. `import 'mikro/wifi'` then throws ReferenceError:
            Native module 'native:mikro/wifi' is not available, the boot
            banner lists no WiFi radio and BoardInfo.features omits
            "wifi". HTTP and SNTP still compile; they need a network
            interface from elsewhere.

            IDF's own CONFIG_ESP_WIFI_ENABLED cannot do this: it has no
            prompt on WiFi-capable chips, so setting it to n in
            sdkconfig.defaults is silently reverted to y.

endmenu

menu "mikrojs runtime memory"

    config MIKROJS_QUICKJS_HEAP_PSRAM
        bool "Allocate QuickJS heap in PSRAM"
        default y if SPIRAM
        depends on SPIRAM
        help
            When enabled, the QuickJS engine allocates its heap from PSRAM
            instead of internal SRAM. This frees roughly 150-250 KB of
            contiguous internal SRAM for mbedTLS handshake buffers, WiFi
            and BLE driver state, and DMA-capable buffers — the most
            common cause of HTTPS handshake failures (error 0x7002) on
            apps with significant retained JS state.

            Cost: PSRAM has higher access latency than internal SRAM,
            so JS execution is somewhat slower. For typical embedded
            JS workloads (event-driven, IO-bound) this is invisible
            against networking and IO costs, while HTTPS reliability
            matters.

            Defaults on for chips with PSRAM. Disable if your workload
            is JS-execution-bound and you can fit the JS heap in
            internal SRAM. No effect on chips without PSRAM.

endmenu

menu "mikrojs Test Configuration"

    config MIKROJS_TEST_GPIO_PIN
        int "GPIO pin for output/input tests"
        default 15 if IDF_TARGET_ESP32C6
        default 8 if IDF_TARGET_ESP32C3
        default 2
        help
            GPIO pin used by the hardware test suite for digital write/read tests.
            Should be a safe, general-purpose pin on the target board (ideally an LED).

    config MIKROJS_TEST_PWM_PIN
        int "GPIO pin for PWM/LEDC tests"
        default 15 if IDF_TARGET_ESP32C6
        default 8 if IDF_TARGET_ESP32C3
        default 2
        help
            GPIO pin used by the hardware test suite for PWM (LEDC) tests.
            Should be a safe, general-purpose pin on the target board (ideally an LED).

    config MIKROJS_TEST_ADC_PIN
        int "GPIO pin for ADC tests"
        default 0 if IDF_TARGET_ESP32C6
        default 0 if IDF_TARGET_ESP32C3
        default 1 if IDF_TARGET_ESP32S3
        default 34
        help
            GPIO pin used by the hardware test suite for ADC read tests.
            Must be connected to an ADC1 channel on the target chip.

endmenu
```
