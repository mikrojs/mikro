## packages/@mikrojs/firmware/sdkconfig.defaults
```kconfig
# --- Task & stack sizes ---
# Main task runs the mikrojs runtime directly. Deep JS → native → JS chains
# overflow 16 KB; 24 KB gives ~8 KB headroom with no observed waste on
# simpler apps. See packages/@mikrojs/firmware/components/mikrojs/MEMORY_ANALYSIS.md.
CONFIG_ESP_MAIN_TASK_STACK_SIZE=24576
CONFIG_ESP_SYSTEM_EVENT_TASK_STACK_SIZE=4096
CONFIG_ESP_MINIMAL_SHARED_STACK_SIZE=2048

# --- Partition table ---
CONFIG_PARTITION_TABLE_CUSTOM=y
# CONFIG_PARTITION_TABLE_CUSTOM_FILENAME is set by project.cmake

# --- Flash ---
CONFIG_ESPTOOLPY_FLASHFREQ="80m"
# ESP-IDF defaults C6 (and some others) to 2MB flash. Modern dev kits ship
# with 4MB+, and the partition table grew past 2MB once BLE was enabled.
CONFIG_ESPTOOLPY_FLASHSIZE="4MB"
CONFIG_ESPTOOLPY_FLASHSIZE_4MB=y

# --- RAM optimization ---
# Use -Os to reduce code size (less IRAM pressure, smaller function frames)
CONFIG_COMPILER_OPTIMIZATION_SIZE=y

# Move system functions from IRAM to flash (IRAM and DRAM share the same
# SRAM on single-core chips like C3/C6, so freeing IRAM also frees DRAM)
CONFIG_HEAP_PLACE_FUNCTION_INTO_FLASH=y
CONFIG_FREERTOS_PLACE_FUNCTIONS_INTO_FLASH=y
CONFIG_RINGBUF_PLACE_FUNCTIONS_INTO_FLASH=y

# Trade WiFi throughput for ~15-20KB IRAM savings. Fine for mikrojs
# workloads (HTTP requests, small payloads — not high-throughput streaming).
CONFIG_ESP_WIFI_IRAM_OPT=n
CONFIG_ESP_WIFI_RX_IRAM_OPT=n

# SPI master ISR doesn't need to run during flash writes
CONFIG_SPI_MASTER_ISR_IN_IRAM=n

# No ISRs post events while cache is disabled
CONFIG_ESP_EVENT_POST_FROM_IRAM_ISR=n

# Keep UART ISR in IRAM so it runs during flash writes (LittleFS).
# Without this, the 128-byte RX FIFO overflows during deploy.
CONFIG_UART_ISR_IN_IRAM=y

# --- LittleFS ---
# Track modification time so fs.stat() / fs.readDir() surface mtime
# (exposed as ms-since-epoch on the StatResult object).
CONFIG_LITTLEFS_USE_MTIME=y

# --- Logging ---
# Production default: NONE. No log output on serial console, keeps the
# REPL protocol stream clean. The bootloader is also silenced.
#
# CONFIG_LOG_DYNAMIC_LEVEL_CONTROL=y enables esp_log_level_set() at
# runtime, which we use in mik__apply_nvs_log_level() to flip specific
# mikrojs tags to DEBUG based on the MIK_LOG_LEVEL NVS env var. This
# costs a few hundred bytes of flash (the tag-level hash table) and
# near-zero RAM.
#
# We intentionally do NOT raise CONFIG_LOG_MAXIMUM_LEVEL. libmikrojs's
# log calls go through platform->log → esp_log_writev (a real function
# call, not a macro), so they're always compiled in and only filtered
# at runtime. Raising MAXIMUM_LEVEL would pull in debug format strings
# from every ESP-IDF subsystem (BLE/WiFi/lwIP/drivers) — measured at
# +121 KB flash + 3 KB RAM on ESP32-C6. Not worth it for dev
# diagnostics we can already get via the runtime path.
CONFIG_LOG_DEFAULT_LEVEL_NONE=y
CONFIG_LOG_DEFAULT_LEVEL=0
CONFIG_LOG_DYNAMIC_LEVEL_CONTROL=y
CONFIG_BOOTLOADER_LOG_LEVEL_NONE=y
CONFIG_BOOTLOADER_LOG_LEVEL=0

# --- Bluetooth / BLE (NimBLE host, peripheral + broadcaster roles) ---
CONFIG_BT_ENABLED=y
CONFIG_BT_NIMBLE_ENABLED=y
CONFIG_BT_BLUEDROID_ENABLED=n
CONFIG_BT_NIMBLE_ROLE_PERIPHERAL=y
CONFIG_BT_NIMBLE_ROLE_BROADCASTER=y
CONFIG_BT_NIMBLE_ROLE_CENTRAL=n
CONFIG_BT_NIMBLE_ROLE_OBSERVER=n
CONFIG_BT_NIMBLE_HOST_TASK_STACK_SIZE=4096
CONFIG_BT_NIMBLE_ATT_PREFERRED_MTU=256
# Software coexistence for chips that share the 2.4 GHz radio between WiFi and BLE
# (ESP32, ESP32-S3, ESP32-C3). Harmless on chips with separate radios (ESP32-C6).
CONFIG_ESP_COEX_SW_COEXIST_ENABLE=y

# Disable unused C++ features
CONFIG_COMPILER_CXX_EXCEPTIONS=n
CONFIG_COMPILER_CXX_RTTI=n

# Disable unused VFS features (~6KB savings)
CONFIG_VFS_SUPPORT_SELECT=n

# --- Assertions & error strings ---
CONFIG_COMPILER_OPTIMIZATION_CHECKS_SILENT=y
CONFIG_ESP_ERR_TO_NAME_LOOKUP=n
CONFIG_HAL_DEFAULT_ASSERTION_LEVEL=0

# --- lwIP ---
# IPv6 enabled so mikrojs/udp dual-stack sockets work and to keep the
# door open for Thread (which is IPv6-only). Required for AF_INET6 /
# sockaddr_in6 to be defined in lwIP headers — without it, the UDP
# native module won't even compile. Cost is roughly 5–10 KB flash.
CONFIG_LWIP_IPV6=y

# --- MbedTLS: TLS 1.2 + 1.3, AES-GCM/CCM, ECDHE ---
CONFIG_MBEDTLS_SSL_PROTO_TLS1_3=y
# Disable unused features
CONFIG_MBEDTLS_SSL_RENEGOTIATION=n
CONFIG_MBEDTLS_SSL_ALPN=y
CONFIG_MBEDTLS_PKCS7_C=n
CONFIG_MBEDTLS_PEM_WRITE_C=n

CONFIG_MBEDTLS_X509_CRL_PARSE_C=n
CONFIG_MBEDTLS_X509_CSR_PARSE_C=n

CONFIG_MBEDTLS_ERROR_STRINGS=n
CONFIG_MBEDTLS_FS_IO=n

# Disable rarely used ECC curves (keep P-256, P-384, Curve25519)
# Note: secp192r1, secp224r1, secp192k1, secp224k1 removed in MbedTLS 4.x
CONFIG_MBEDTLS_ECP_DP_SECP521R1_ENABLED=n
CONFIG_MBEDTLS_ECP_DP_SECP256K1_ENABLED=n
CONFIG_MBEDTLS_ECP_DP_BP256R1_ENABLED=n
CONFIG_MBEDTLS_ECP_DP_BP384R1_ENABLED=n
CONFIG_MBEDTLS_ECP_DP_BP512R1_ENABLED=n

# Use smaller cert bundle (common CAs only)
CONFIG_MBEDTLS_CERTIFICATE_BUNDLE_DEFAULT_CMN=y
CONFIG_MBEDTLS_CERTIFICATE_BUNDLE_CROSS_SIGNED_VERIFY=y
```

## packages/@mikrojs/firmware/sdkconfig.defaults.esp32
```kconfig
# ESP32: uses UART for console I/O
# No overrides needed — base sdkconfig.defaults handles UART targets.

# Enable PSRAM if present (e.g. WROVER modules with 4-8 MB).
# IGNORE_NOTFOUND: fall back to internal SRAM if not present.
CONFIG_SPIRAM=y
CONFIG_SPIRAM_USE_MALLOC=y
CONFIG_SPIRAM_IGNORE_NOTFOUND=y
```

## packages/@mikrojs/firmware/sdkconfig.defaults.esp32c3
```kconfig
# ESP32-C3: route ESP-IDF stdio/ESP_LOG to UART0 rather than the
# built-in USB Serial/JTAG. See sdkconfig.defaults.esp32c6 for the
# reasoning (avoid ESP-IDF auto-registering the USB-JTAG VFS / stdio
# stack at boot). mikrojs installs the USB-Serial/JTAG driver itself
# via the public API in mik_serial_io.cpp for REPL/TLV transport.
#
# Secondary console on USB-Serial/JTAG so panic dumps + bootloader
# messages still reach a dev monitor attached over USB (the primary
# UART usually isn't wired up on dev boards). ESP-IDF writes panic
# output directly to USB-JTAG hardware registers, which doesn't
# conflict with mikrojs's driver-level registration for regular
# REPL traffic.
CONFIG_ESP_CONSOLE_UART_DEFAULT=y
CONFIG_ESP_CONSOLE_USB_SERIAL_JTAG=n
CONFIG_ESP_CONSOLE_SECONDARY_USB_SERIAL_JTAG=y
```

## packages/@mikrojs/firmware/sdkconfig.defaults.esp32c5
```kconfig
# ESP32-C5: same console story as C6 (UART primary, USB-Serial/JTAG
# secondary). See sdkconfig.defaults.esp32c6 for the reasoning around
# avoiding ESP-IDF's USB-JTAG VFS at boot. mikrojs installs the
# USB-Serial/JTAG driver itself for REPL/TLV transport; auto-detection
# latches to whichever interface receives the first byte.
CONFIG_ESP_CONSOLE_UART_DEFAULT=y
CONFIG_ESP_CONSOLE_USB_SERIAL_JTAG=n
CONFIG_ESP_CONSOLE_SECONDARY_USB_SERIAL_JTAG=y

# Enable PSRAM. Quad SPI is the only supported mode on ESP32-C5.
# IGNORE_NOTFOUND so the same firmware boots on bare C5 modules too,
# falling back to internal SRAM only.
CONFIG_SPIRAM=y
CONFIG_SPIRAM_USE_MALLOC=y
CONFIG_SPIRAM_IGNORE_NOTFOUND=y
```

## packages/@mikrojs/firmware/sdkconfig.defaults.esp32c6
```kconfig
# ESP32-C6: route ESP-IDF stdio/ESP_LOG to UART0 rather than the
# built-in USB Serial/JTAG. This prevents ESP-IDF's startup code from
# registering the USB-JTAG VFS and pulling it into newlib's stdio
# before app_main() runs — an early-boot init sequence heavy enough
# to tip marginal battery supplies past brown-out on some boards.
#
# mikrojs still exposes USB-Serial/JTAG as a REPL/TLV transport — see
# mik_serial_io.cpp, which installs the USB-Serial/JTAG driver through
# the public API and bypasses VFS entirely. Auto-detection picks
# whichever interface receives the first byte, same UX as before.
#
# ESP_LOG going to UART is harmless in production (we ship with
# CONFIG_LOG_DEFAULT_LEVEL_NONE=y); for dev, plug a USB-TTL onto
# UART0 TX/RX to see logs — or re-enable the USB-JTAG console per
# project if a given board isn't battery-boot-constrained.
#
# Secondary console on USB-Serial/JTAG: keeps panic dumps + bootloader
# messages reachable via the USB monitor even though the primary
# console is UART0. Without this, a panic is invisible to anyone
# monitoring over USB (which is most dev boards), because the panic
# handler writes to the primary console only. During a panic ESP-IDF
# writes directly to the USB-JTAG hardware registers — it doesn't
# conflict with mikrojs's driver-level USB-JTAG use for REPL traffic.
CONFIG_ESP_CONSOLE_UART_DEFAULT=y
CONFIG_ESP_CONSOLE_USB_SERIAL_JTAG=n
CONFIG_ESP_CONSOLE_SECONDARY_USB_SERIAL_JTAG=y
```

## packages/@mikrojs/firmware/sdkconfig.defaults.esp32s3
```kconfig
# ESP32-S3: route ESP-IDF stdio/ESP_LOG to UART0 rather than the
# built-in USB Serial/JTAG. See sdkconfig.defaults.esp32c6 for the
# reasoning (avoid ESP-IDF auto-registering the USB-JTAG VFS / stdio
# stack at boot). mikrojs installs the USB-Serial/JTAG driver itself
# via the public API in mik_serial_io.cpp for REPL/TLV transport.
#
# Secondary console on USB-Serial/JTAG so panic dumps + bootloader
# messages still reach a dev monitor attached over USB (the primary
# UART usually isn't wired up on dev boards). ESP-IDF writes panic
# output directly to USB-JTAG hardware registers, which doesn't
# conflict with mikrojs's driver-level registration for regular
# REPL traffic.
CONFIG_ESP_CONSOLE_UART_DEFAULT=y
CONFIG_ESP_CONSOLE_USB_SERIAL_JTAG=n
CONFIG_ESP_CONSOLE_SECONDARY_USB_SERIAL_JTAG=y

# Enable PSRAM if present. Default mode is quad; boards with octal PSRAM
# (e.g. XIAO ESP32-S3) must override with CONFIG_SPIRAM_MODE_OCT=y.
# IGNORE_NOTFOUND: fall back to internal SRAM if PSRAM init fails.
CONFIG_SPIRAM=y
CONFIG_SPIRAM_USE_MALLOC=y
CONFIG_SPIRAM_IGNORE_NOTFOUND=y
```

## packages/@mikrojs/firmware/test/sdkconfig.defaults
```kconfig
# --- Task & stack sizes ---
CONFIG_ESP_MAIN_TASK_STACK_SIZE=16384
CONFIG_ESP_SYSTEM_EVENT_TASK_STACK_SIZE=4096
CONFIG_ESP_MINIMAL_SHARED_STACK_SIZE=2048

# --- Partition table ---
CONFIG_PARTITION_TABLE_CUSTOM=y
CONFIG_PARTITION_TABLE_CUSTOM_FILENAME="littlefs_partition.csv"

# --- Flash ---
# Test partition layout needs > 2MB (factory 0x1E0000 + littlefs 0x30000 + header).
CONFIG_ESPTOOLPY_FLASHSIZE_4MB=y
CONFIG_ESPTOOLPY_FLASHSIZE="4MB"
CONFIG_ESPTOOLPY_FLASHFREQ="80m"

# --- RAM optimization ---
CONFIG_COMPILER_OPTIMIZATION_SIZE=y
CONFIG_HEAP_PLACE_FUNCTION_INTO_FLASH=y
CONFIG_FREERTOS_PLACE_FUNCTIONS_INTO_FLASH=y
CONFIG_RINGBUF_PLACE_FUNCTIONS_INTO_FLASH=y
CONFIG_ESP_WIFI_IRAM_OPT=n
CONFIG_ESP_WIFI_RX_IRAM_OPT=n
CONFIG_SPI_MASTER_ISR_IN_IRAM=n
CONFIG_ESP_EVENT_POST_FROM_IRAM_ISR=n
CONFIG_UART_ISR_IN_IRAM=y

# --- Logging ---
CONFIG_LOG_DEFAULT_LEVEL=1
CONFIG_LOG_MAXIMUM_LEVEL=3
CONFIG_LOG_DYNAMIC_LEVEL_CONTROL=n
CONFIG_LOG_IN_IRAM=n
CONFIG_BOOTLOADER_LOG_LEVEL=1

# --- Binary size ---
CONFIG_BT_ENABLED=n
CONFIG_COMPILER_CXX_EXCEPTIONS=n
CONFIG_COMPILER_CXX_RTTI=n
CONFIG_VFS_SUPPORT_SELECT=n
CONFIG_COMPILER_OPTIMIZATION_CHECKS_SILENT=y
CONFIG_ESP_ERR_TO_NAME_LOOKUP=n
CONFIG_HAL_DEFAULT_ASSERTION_LEVEL=0
# IPv6 on so the UDP native module compiles (AF_INET6 / sockaddr_in6
# come from lwIP headers gated on LWIP_IPV6).
CONFIG_LWIP_IPV6=y

# --- Test-specific ---
CONFIG_ESP_TASK_WDT_EN=n
CONFIG_UNITY_ENABLE_COLOR=y
```

## packages/@mikrojs/firmware/test/sdkconfig.defaults.esp32
```kconfig
# ESP32: uses UART for console I/O
# No overrides needed — base sdkconfig.defaults handles UART targets.

# Enable PSRAM if present (e.g. WROVER modules with 4-8 MB).
CONFIG_SPIRAM=y
CONFIG_SPIRAM_USE_MALLOC=y
CONFIG_SPIRAM_IGNORE_NOTFOUND=y
```

## packages/@mikrojs/firmware/test/sdkconfig.defaults.esp32c3
```kconfig
# ESP32-C3: route ESP-IDF stdio/ESP_LOG to UART0; mikrojs owns the
# USB-Serial/JTAG peripheral directly via the driver API (see
# components/mikrojs/mik_serial_io.cpp).
CONFIG_ESP_CONSOLE_UART_DEFAULT=y
CONFIG_ESP_CONSOLE_USB_SERIAL_JTAG=n
```

## packages/@mikrojs/firmware/test/sdkconfig.defaults.esp32c6
```kconfig
# ESP32-C6: route ESP-IDF stdio/ESP_LOG to UART0; mikrojs owns the
# USB-Serial/JTAG peripheral directly via the driver API (see
# components/mikrojs/mik_serial_io.cpp).
CONFIG_ESP_CONSOLE_UART_DEFAULT=y
CONFIG_ESP_CONSOLE_USB_SERIAL_JTAG=n
```

## packages/@mikrojs/firmware/test/sdkconfig.defaults.esp32s3
```kconfig
# ESP32-S3: route ESP-IDF stdio/ESP_LOG to UART0; mikrojs owns the
# USB-Serial/JTAG peripheral directly via the driver API (see
# components/mikrojs/mik_serial_io.cpp).
CONFIG_ESP_CONSOLE_UART_DEFAULT=y
CONFIG_ESP_CONSOLE_USB_SERIAL_JTAG=n

# Enable PSRAM if present. Default mode is quad; octal boards need
# CONFIG_SPIRAM_MODE_OCT=y. Falls back to internal SRAM if init fails.
CONFIG_SPIRAM=y
CONFIG_SPIRAM_USE_MALLOC=y
CONFIG_SPIRAM_IGNORE_NOTFOUND=y
```

## packages/@mikrojs/waveshare/boards/esp32-s3-knob-touch-lcd-1.8/sdkconfig.defaults
```kconfig
# Waveshare ESP32-S3-Knob-Touch-LCD-1.8
# ESP32-S3 with 16MB flash, octal PSRAM

CONFIG_ESPTOOLPY_FLASHSIZE_16MB=y
CONFIG_SPIRAM=y
CONFIG_SPIRAM_MODE_OCT=y
CONFIG_SPIRAM_SPEED_80M=y
CONFIG_ESP_DEFAULT_CPU_FREQ_MHZ_240=y
```

## sdkconfig.defaults
```kconfig
CONFIG_ESP_SYSTEM_EVENT_TASK_STACK_SIZE=32768
CONFIG_ESP_MAIN_TASK_STACK_SIZE=32768
```

## test/sdkconfig.defaults
```kconfig
CONFIG_ESP_TASK_WDT_EN=n
CONFIG_ESP_CONSOLE_USB_SERIAL_JTAG=y
CONFIG_UNITY_ENABLE_COLOR=y
```
